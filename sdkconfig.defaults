## sdkconfig.defaults
```kconfig
#
# Arduino ESP32
#
# CONFIG_AUTOSTART_ARDUINO=y
# end of Arduino ESP32

#
# FREERTOS
#
# CONFIG_FREERTOS_HZ=1000
# end of FREERTOS
# end of Component config

# TLS 

CONFIG_MBEDTLS_PSK_MODES=y
CONFIG_MBEDTLS_KEY_EXCHANGE_PSK=y
CONFIG_MBEDTLS_KEY_EXCHANGE_ECDHE_PSK=y
CONFIG_MBEDTLS_KEY_EXCHANGE_RSA_PSK=y

# OPENETH
CONFIG_ETH_USE_OPENETH=y

# LWIP
CONFIG_LWIP_IPV6=n
```
